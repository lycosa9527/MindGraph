## esp32/boards/waveshare/esp32_s3_touch_lcd_1_85c/sdkconfig.defaults.board
```kconfig
CONFIG_ESPTOOLPY_FLASHMODE_QIO=y
CONFIG_ESPTOOLPY_FLASHSIZE_16MB=y
CONFIG_ESPTOOLPY_FLASHFREQ_80M=y
CONFIG_PARTITION_TABLE_CUSTOM=y
CONFIG_PARTITION_TABLE_CUSTOM_FILENAME="partitions_16m.csv"
CONFIG_PARTITION_TABLE_FILENAME="partitions_16m.csv"
CONFIG_SPIRAM=y
CONFIG_SPIRAM_MODE_OCT=y
CONFIG_SPIRAM_SPEED_80M=y
# Code stays in flash (ESP-IDF default). Fetch-to-PSRAM would copy ~5.5MB
# of .text and leave only ~2.5MB heap on this 8MB part.
CONFIG_SPIRAM_FETCH_INSTRUCTIONS=n
CONFIG_SPIRAM_MALLOC_ALWAYSINTERNAL=0
CONFIG_SPIRAM_TRY_ALLOCATE_WIFI_LWIP=y
CONFIG_SPIRAM_ALLOW_BSS_SEG_EXTERNAL_MEMORY=y
CONFIG_ESP_DEFAULT_CPU_FREQ_MHZ_240=y
CONFIG_ESP_CONSOLE_USB_SERIAL_JTAG=y
# Adaptor 0.8.4 requires greater than 3072.
CONFIG_ESP_SYSTEM_EVENT_TASK_STACK_SIZE=4096

CONFIG_BROOKESIA_HAL_ADAPTOR_ENABLE_SYSTEM_DEVICE=y
CONFIG_BROOKESIA_HAL_ADAPTOR_SYSTEM_ENABLE_BOARD_INFO_IMPL=y
CONFIG_BROOKESIA_HAL_ADAPTOR_ENABLE_NETWORK_DEVICE=y
CONFIG_BROOKESIA_HAL_ADAPTOR_ENABLE_WIFI_DEVICE=y
CONFIG_ESP_BOARD_PERIPH_GPIO_SUPPORT=y
CONFIG_ESP_BOARD_PERIPH_I2C_SUPPORT=y
CONFIG_ESP_BOARD_PERIPH_I2S_SUPPORT=y
CONFIG_ESP_BOARD_PERIPH_LEDC_SUPPORT=y
CONFIG_ESP_BOARD_PERIPH_SPI_SUPPORT=y
CONFIG_ESP_BOARD_DEV_AUDIO_CODEC_SUPPORT=y
# V1 PCM5101 is I2S-only (chip=internal → dummy). Stock codec list is
# ES8311/ES7210 and leaves dummy off, so audio_dac init fails and HAL
# then tears down audio_adc with it.
CONFIG_CODEC_DUMMY_SUPPORT=y
CONFIG_ESP_BOARD_DEV_DISPLAY_LCD_SUPPORT=y
CONFIG_ESP_BOARD_DEV_GPIO_EXPANDER_SUPPORT=y
CONFIG_ESP_BOARD_DEV_LCD_TOUCH_SUPPORT=y
CONFIG_ESP_BOARD_DEV_LEDC_CTRL_SUPPORT=y
CONFIG_ESP_BOARD_DEV_DISPLAY_LCD_SUB_SPI_SUPPORT=y
CONFIG_ESP_BOARD_DEV_LCD_TOUCH_SUB_I2C_SUPPORT=y
CONFIG_ESP_BOARD_DEV_LCD_TOUCH_I2C_SUPPORT=y

# V1 PCM5101 + MEMS I2S. Player/recorder only — no AFE/WakeNet/XiaoZhi.
CONFIG_BROOKESIA_HAL_ADAPTOR_ENABLE_AUDIO_DEVICE=y
CONFIG_BROOKESIA_HAL_ADAPTOR_AUDIO_ENABLE_CODEC_PLAYER_IMPL=y
CONFIG_BROOKESIA_HAL_ADAPTOR_AUDIO_ENABLE_CODEC_RECORDER_IMPL=y
CONFIG_BROOKESIA_HAL_ADAPTOR_AUDIO_ENABLE_PROCESSOR_IMPL=n
CONFIG_BROOKESIA_HAL_ADAPTOR_AUDIO_CODEC_RECORDER_BITS=16
CONFIG_BROOKESIA_HAL_ADAPTOR_AUDIO_CODEC_RECORDER_CHANNELS=1
CONFIG_BROOKESIA_HAL_ADAPTOR_AUDIO_CODEC_RECORDER_SAMPLE_RATE=16000
CONFIG_BROOKESIA_HAL_ADAPTOR_AUDIO_CODEC_RECORDER_MIC_LAYOUT="M"

CONFIG_BROOKESIA_HAL_ADAPTOR_ENABLE_DISPLAY_DEVICE=y
CONFIG_BROOKESIA_HAL_ADAPTOR_DISPLAY_ENABLE_LEDC_BACKLIGHT_IMPL=y
CONFIG_BROOKESIA_HAL_ADAPTOR_DISPLAY_ENABLE_LCD_PANEL_IMPL=y
CONFIG_BROOKESIA_HAL_ADAPTOR_DISPLAY_LCD_PANEL_H_RES=360
CONFIG_BROOKESIA_HAL_ADAPTOR_DISPLAY_LCD_PANEL_V_RES=360
CONFIG_BROOKESIA_HAL_ADAPTOR_DISPLAY_LCD_PANEL_DRAW_X_ALIGN_BYTES=2
CONFIG_BROOKESIA_HAL_ADAPTOR_DISPLAY_LCD_PANEL_DRAW_Y_ALIGN_BYTES=2
CONFIG_BROOKESIA_HAL_ADAPTOR_DISPLAY_ENABLE_LCD_TOUCH_IMPL=y

CONFIG_BROOKESIA_HAL_ADAPTOR_ENABLE_STORAGE_DEVICE=y
CONFIG_BROOKESIA_HAL_ADAPTOR_STORAGE_ENABLE_KEY_VALUE_IMPL=y
CONFIG_BROOKESIA_HAL_ADAPTOR_STORAGE_ENABLE_FILE_SYSTEM_IMPL=y
CONFIG_BROOKESIA_HAL_ADAPTOR_STORAGE_FILE_SYSTEM_ENABLE_LITTLEFS=y
CONFIG_BROOKESIA_HAL_ADAPTOR_STORAGE_FILE_SYSTEM_ENABLE_SDCARD=n
CONFIG_BROOKESIA_HAL_ADAPTOR_ENABLE_POWER_DEVICE=n
```

## esp32/firmware/1.85c/main/Kconfig.projbuild
```kconfig
menu "MindGraph 1.85C station"

    config MINDGRAPH_STA_SSID
        string "Home AP SSID (empty disables boot connect)"
        default ""
        help
            Seeded at boot after a full-flash (NVS is wiped at 0x00).
            Prefer sdkconfig.defaults.local so the password stays untracked.

    config MINDGRAPH_STA_PASSWORD
        string "Home AP password"
        default ""
        help
            Used only when MINDGRAPH_STA_SSID is non-empty.

    config MINDGRAPH_STA_TIMEZONE
        string "POSIX timezone for the status clock"
        default "CST-8"
        help
            Settings China option is CST-8 (UTC+8). Applied at boot so the
            clock is not UTC after NVS is wiped.

    config MINDGRAPH_KITTY_SERVER_URL
        string "MindGraph origin for Kitty watch (https://host or http://host:9527)"
        default ""
        help
            Used by the mobile-lane Kitty client. Prefer sdkconfig.defaults.local.

    config MINDGRAPH_KITTY_MGAT
        string "Baked mgat_ API token (required for Kitty watch)"
        default ""
        help
            Watch auth is flash-time only. Prefer sdkconfig.defaults.local.
            Do not commit. Empty means the watch cannot authenticate.

    config MINDGRAPH_KITTY_ACCOUNT
        string "X-MG-Account phone for baked mgat_"
        default ""
        help
            Phone bound to the baked token. Prefer sdkconfig.defaults.local.

endmenu
```

## esp32/firmware/1.85c/sdkconfig.defaults.esp32s3
```kconfig
CONFIG_COMPILER_OPTIMIZATION_PERF=y
CONFIG_SR_WN_WN9_HIESP=y

# Brookesia:System Super
CONFIG_BROOKESIA_SYSTEM_SUPER_ENABLE_APP_LAUNCH_ANIMATION=n
CONFIG_BROOKESIA_SYSTEM_SUPER_ENABLE_RESOURCE_FONT_COPY=y

# Instructions stay in flash. Do not copy .text into the 8MB PSRAM.
CONFIG_SPIRAM_FETCH_INSTRUCTIONS=n

# Settings/Files GUI DOM is loaded when the app opens, not at Super install.
CONFIG_BROOKESIA_APP_SETTINGS_ENABLE_PRELOAD_DOM=n
CONFIG_BROOKESIA_APP_FILES_ENABLE_PRELOAD_DOM=n
CONFIG_BROOKESIA_APP_SETTINGS_WIFI_MAX_VISIBLE_APS=3

# WiFi
CONFIG_ESP_WIFI_STATIC_RX_BUFFER_NUM=6
CONFIG_ESP_WIFI_STATIC_TX_BUFFER_NUM=6
CONFIG_ESP_WIFI_DYNAMIC_RX_MGMT_BUFFER=y
CONFIG_ESP_WIFI_TX_BA_WIN=16
CONFIG_ESP_WIFI_RX_BA_WIN=8
CONFIG_ESP_WIFI_IRAM_OPT=n
CONFIG_ESP_WIFI_RX_IRAM_OPT=n
CONFIG_LWIP_IRAM_OPTIMIZATION=n
CONFIG_LWIP_TCP_RECVMBOX_SIZE=10
CONFIG_LWIP_TCP_ACCEPTMBOX_SIZE=8
CONFIG_LWIP_TCP_OOSEQ_MAX_PBUFS=6

# GUI
CONFIG_LV_CACHE_DEF_SIZE=327680
CONFIG_LV_IMAGE_HEADER_CACHE_DEF_CNT=16
CONFIG_LV_FONT_MONTSERRAT_8=y
CONFIG_LV_FONT_MONTSERRAT_12=y
CONFIG_LV_FONT_MONTSERRAT_16=y
CONFIG_LV_FONT_MONTSERRAT_20=y
CONFIG_LV_FONT_MONTSERRAT_24=y
CONFIG_LV_FONT_MONTSERRAT_28=y
CONFIG_LV_FONT_MONTSERRAT_32=y
CONFIG_LV_FONT_MONTSERRAT_36=y
CONFIG_LV_FONT_MONTSERRAT_40=y
CONFIG_LV_FONT_MONTSERRAT_44=y
CONFIG_LV_FONT_MONTSERRAT_48=y
CONFIG_BROOKESIA_GUI_LVGL_DISPLAY_SOURCE_BUFFER_HEIGHT=50
CONFIG_BROOKESIA_GUI_LVGL_DISPLAY_SOURCE_REQUIRE_DOUBLE_BUFFER=y
```
