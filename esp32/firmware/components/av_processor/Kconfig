## esp32/firmware/components/av_processor/Kconfig
```kconfig
menu "Audio/Video Processor Configuration"

    config MEDIA_DUMP_ENABLE
        bool "Enable Media Dump"
        default n
        help
            Enable or disable the media dump feature.
            When disabled, all related options are hidden.

    choice MEDIA_DUMP_AUDIO_POINT
        prompt "Audio Save Mode (AEC Point)"
        depends on MEDIA_DUMP_ENABLE
        default MEDIA_DUMP_AUDIO_NONE

        config MEDIA_DUMP_AUDIO_BEFORE_AEC
            bool "Save Before AEC"
            help
                Save media data captured before AEC processing.

        config MEDIA_DUMP_AUDIO_AFTER_AEC
            bool "Save After AEC"
            help
                Save media data after AEC processing.

        config MEDIA_DUMP_AUDIO_NONE
            bool "None"
            help
                Do not save any media data.

    endchoice

    config MEDIA_DUMP_DURATION_SEC
        int "Dump Duration (seconds)"
        depends on MEDIA_DUMP_ENABLE
        default 20
        range 1 3600
        help
            Maximum duration to capture media dump in seconds.

    choice MEDIA_DUMP_SINK
        prompt "Media Dump Output Method"
        depends on MEDIA_DUMP_ENABLE
        default MEDIA_DUMP_SINK_SDCARD

        config MEDIA_DUMP_SINK_UDP
            bool "UDP"
            help
                Send media dump output through UDP.

        config MEDIA_DUMP_SINK_SDCARD
            bool "SD Card File"
            help
                Save media dump output to persistent storage on the SD card.

    endchoice

    if MEDIA_DUMP_SINK_UDP

        config MEDIA_DUMP_UDP_IP
            string "UDP Destination IP"
            default "192.168.1.100"
            help
                Specify the destination IPv4 address for UDP output.

        config MEDIA_DUMP_UDP_PORT
            int "UDP Destination Port"
            default 5000
            range 1 65535
            help
                Specify the destination UDP port number.

    endif

    if MEDIA_DUMP_SINK_SDCARD

        config MEDIA_DUMP_SDCARD_FILENAME
            string "SD Card File Name"
            default "/sdcard/media_dump.bin"
            help
                Specify the file path used to store media dump output.

    endif

endmenu
```

## esp32/firmware/managed_components/espressif__gmf_loader/Kconfig.projbuild
```kconfig
menu "ESP GMF Loader"

    rsource "Kconfigs/kconfig.io"
    rsource "Kconfigs/kconfig.audio"
    rsource "Kconfigs/kconfig.video"
    rsource "Kconfigs/kconfig.misc"

endmenu
```

## esp32/firmware/managed_components/espressif__gmf_loader/Kconfigs/kconfig.audio
```kconfig
menu "GMF Audio Configurations"

    rsource "kconfig.audio_codec"
    rsource "kconfig.audio_effects"
    rsource "kconfig.ai_audio"

endmenu
```

## esp32/firmware/managed_components/espressif__gmf_loader/Kconfigs/kconfig.audio_codec
```kconfig
menu "GMF Audio Codec"

    rsource "kconfig.audio_codec.dec"
    rsource "kconfig.audio_codec.enc"

endmenu
```

## esp32/firmware/managed_components/espressif__gmf_loader/Kconfigs/kconfig.fourcc
```kconfig
# FourCC Values Definition
#
# This file defines all FourCC format codes used in video effects
# Values are derived from esp_fourcc.h

#####################################################################
#                         Video Codec FourCC                          #
#####################################################################
config FOURCC_H263
    hex
    default 0x48323633     # H263: H263

config FOURCC_H264
    hex
    default 0x48323634     # H264: H264 with start code

config FOURCC_AVC1
    hex
    default 0x41564331     # AVC1: H264 without start code

config FOURCC_H265
    hex
    default 0x48323635     # H265: HEVC

config FOURCC_VP8
    hex
    default 0x56503820     # VP8: VP8

config FOURCC_MJPG
    hex
    default 0x4D4A5047     # MJPG: Motion-JPEG

#####################################################################
#                         RGB Pixel Formats                           #
#####################################################################
config FOURCC_RGB16
    hex
    default 0x4C424752     # RGBL: RGB565 little endian

config FOURCC_BGR16
    hex
    default 0x4C524742     # BGRL: BGR565 little endian

config FOURCC_RGB16_BE
    hex
    default 0x42424752     # RGBB: RGB565 big endian

config FOURCC_BGR16_BE
    hex
    default 0x42524742     # BGRB: BGR565 big endian

config FOURCC_RGB24
    hex
    default 0x33424752     # RGB3: RGB888 24-bit

config FOURCC_BGR24
    hex
    default 0x33524742     # BGR3: BGR888 24-bit

config FOURCC_ARGB32
    hex
    default 0x34324241     # AB24: ARGB888 32-bit

config FOURCC_ABGR32
    hex
    default 0x34325241     # AR24: ABGR888 32-bit

#####################################################################
#                         Grey Pixel Formats                          #
#####################################################################
config FOURCC_GREY
    hex
    default 0x59455247     # GREY: 8-bit Greyscale

config FOURCC_Y16
    hex
    default 0x4C363159     # Y16L: 16-bit Greyscale little endian

config FOURCC_Y16_BE
    hex
    default 0x42363159     # Y16B: 16-bit Greyscale big endian

#####################################################################
#                      YUV Packed Formats                            #
#####################################################################
config FOURCC_YUYV
    hex
    default 0x56595559     # YUYV: YUV 4:2:2 packed

config FOURCC_UYVY
    hex
    default 0x59565955     # UYVY: YUV 4:2:2 packed

config FOURCC_YUV
    hex
    default 0x38303356     # V308: YUV 4:4:4 packed

config FOURCC_OUYY_EVYY
    hex
    default 0x5645554F     # OUEV: Espressif YUV 4:2:0

#####################################################################
#                      YUV Semi-Planar Formats                       #
#####################################################################
config FOURCC_NV12
    hex
    default 0x3231564E     # NV12: YUV 4:2:0 semi-planar

config FOURCC_NV21
    hex
    default 0x3132564E     # NV21: YVU 4:2:0 semi-planar

#####################################################################
#                        YUV Planar Formats                          #
#####################################################################
config FOURCC_YUV420P
    hex
    default 0x32315559     # YU12: YUV 4:2:0 planar

config FOURCC_YVU420P
    hex
    default 0x32315659     # YV12: YVU 4:2:0 planar

config FOURCC_YUV444P
    hex
    default 0x50343434     # 444P: YUV 4:4:4 planar

#####################################################################
#                        Multi-Planar Formats                        #
#####################################################################
config FOURCC_YUV420M
    hex
    default 0x32314D59     # YM12: YUV 4:2:0 multi-planar

config FOURCC_YVU420M
    hex
    default 0x31324D59     # YM21: YVU 4:2:0 multi-planar

config FOURCC_YUV444M
    hex
    default 0x34324D59     # YM24: YUV 4:4:4 multi-planar

#####################################################################
#                           RAW Formats                              #
#####################################################################
config FOURCC_RAW8
    hex
    default 0x38574152     # RAW8: 8-bit raw

config FOURCC_RAW10
    hex
    default 0x41574152     # RAWA: 10-bit raw

config FOURCC_RAW12
    hex
    default 0x43574152     # RAWC: 12-bit raw

config FOURCC_RAW16
    hex
    default 0x47574152     # RAWG: 16-bit raw
```

## esp32/firmware/managed_components/espressif__gmf_loader/Kconfigs/kconfig.io
```kconfig
menu "GMF IO Configurations"

    rsource "kconfig.io.reader"
    rsource "kconfig.io.writer"

endmenu
```

## esp32/firmware/managed_components/espressif__gmf_loader/Kconfigs/kconfig.misc
```kconfig
menu "GMF Miscellaneous"

    config GMF_MISC_INIT_COPIER
        bool "Initialize Miscellaneous Copier"
        default n
        help
            The copier element provides data transfer capabilities between GMF elements:
            - One-to-one: Direct data transfer between two elements
            - One-to-many: Data distribution from one source to multiple destinations
            - Support for both zero-copy and buffered transfer modes

endmenu
```

## esp32/firmware/managed_components/espressif__gmf_loader/Kconfigs/kconfig.video
```kconfig
menu "GMF Video Configurations"

    rsource "kconfig.video_codec"
    rsource "kconfig.video_effects"

endmenu
```

## esp32/firmware/managed_components/espressif__gmf_loader/Kconfigs/kconfig.video_codec
```kconfig
menu "GMF Video Codec"

    rsource "kconfig.video_codec.dec"
    rsource "kconfig.video_codec.enc"

endmenu
```

## esp32/firmware/managed_components/espressif__gmf_loader/Kconfigs/kconfig.video_codec.enc
```kconfig
rsource "kconfig.fourcc"

config GMF_VIDEO_CODEC_INIT_ENCODER
    bool "Initialize Video Encoder"
    default n
    help
        Initialize the video encoder element.

choice
    depends on GMF_VIDEO_CODEC_INIT_ENCODER
    prompt "Video Encoder Configuration"
    default GMF_VIDEO_ENC_CODEC_TYPE_AUTO
    help
        Select the video encoder codec type.

    config GMF_VIDEO_ENC_CODEC_TYPE_AUTO
        bool "Auto"
        help
            Auto select the video encoder codec type.

    config GMF_VIDEO_ENC_CODEC_TYPE_SW_H264
        bool "Software H264"
        help
            Software H264 video encoder.

    config GMF_VIDEO_ENC_CODEC_TYPE_HW_H264
        bool "Hardware H264"
        help
            Hardware H264 video encoder.

    config GMF_VIDEO_ENC_CODEC_TYPE_SW_MJPEG
        bool "Software MJPEG"
        help
            Software MJPEG video encoder.

    config GMF_VIDEO_ENC_CODEC_TYPE_HW_MJPEG
        bool "Hardware MJPEG"
        help
            Hardware MJPEG video encoder.
endchoice

config GMF_VIDEO_ENC_CODEC_TYPE
    hex
    default 0x00000000 if GMF_VIDEO_ENC_CODEC_TYPE_AUTO
    default FOURCC_H264 if GMF_VIDEO_ENC_CODEC_TYPE_SW_H264
    default FOURCC_H264 if GMF_VIDEO_ENC_CODEC_TYPE_HW_H264
    default FOURCC_MJPG if GMF_VIDEO_ENC_CODEC_TYPE_SW_MJPEG
    default FOURCC_MJPG if GMF_VIDEO_ENC_CODEC_TYPE_HW_MJPEG
```

## esp32/firmware/managed_components/espressif__gmf_loader/Kconfigs/kconfig.video_effects.crop
```kconfig
rsource "kconfig.fourcc"

config GMF_VIDEO_EFFECTS_INIT_CROP
    bool "Initialize Video Cropper"
    default n
    help
        Initialize the video cropper element
        This element extracts a region of interest from video frames
        Features:
            - Adjustable crop position (X,Y)
            - Flexible output dimensions
            - Multiple pixel format support
        Common use cases:
            - Region of interest extraction
            - Aspect ratio adjustment
            - Remove unwanted frame areas
        Supported pixel formats: GREY(Y), RGB565(LE/BE), BGR565(LE/BE), RGB888, BGR888, YUV_PACKET

menu "Video Effects Crop Configuration"
    depends on GMF_VIDEO_EFFECTS_INIT_CROP

    config GMF_VIDEO_EFFECTS_CROP_INPUT_WIDTH
        int "Width of the Input Frame"
        default 320
        range 1 65536
        help
            The width resolution of the input frame for cropping
            This should match your input video source resolution
            Common resolutions:
                - 320x240 (QVGA)
                - 640x480 (VGA)
                - 1280x720 (720p)

    config GMF_VIDEO_EFFECTS_CROP_INPUT_HEIGHT
        int "Height of the Input Frame"
        default 240
        range 1 65536
        help
            The height resolution of the input frame for cropping
            This should match your input video source resolution
            Common resolutions:
                - 320x240 (QVGA)
                - 640x480 (VGA)
                - 1280x720 (720p)

    choice
        prompt "Input Pixel Format"
        default GMF_VIDEO_EFFECTS_CROP_INPUT_FMT_RGB565_LE
        help
            Select input pixel format for cropping
            Supported formats: GREY(Y), RGB565(LE/BE), BGR565(LE/BE), RGB888, BGR888, YUV_PACKET

            Format details:
                - GREY(Y): 8-bit grayscale
                - RGB/BGR565: 16-bit color (5-bit R, 6-bit G, 5-bit B)
                - RGB/BGR888: 24-bit true color
                - YUV_PACKET: Packed YUV format

        config GMF_VIDEO_EFFECTS_CROP_INPUT_FMT_GREY
            bool "GREY (Y)"
        config GMF_VIDEO_EFFECTS_CROP_INPUT_FMT_RGB565_LE
            bool "RGB565 Little Endian"
        config GMF_VIDEO_EFFECTS_CROP_INPUT_FMT_BGR565_LE
            bool "BGR565 Little Endian"
        config GMF_VIDEO_EFFECTS_CROP_INPUT_FMT_RGB565_BE
            bool "RGB565 Big Endian"
        config GMF_VIDEO_EFFECTS_CROP_INPUT_FMT_BGR565_BE
            bool "BGR565 Big Endian"
        config GMF_VIDEO_EFFECTS_CROP_INPUT_FMT_RGB888
            bool "RGB888"
        config GMF_VIDEO_EFFECTS_CROP_INPUT_FMT_BGR888
            bool "BGR888"
        config GMF_VIDEO_EFFECTS_CROP_INPUT_FMT_YUV_PACKET
            bool "YUV Packet"
    endchoice

    config GMF_VIDEO_EFFECTS_CROP_INPUT_PIXEL_FORMAT
        hex
        default FOURCC_GREY     if GMF_VIDEO_EFFECTS_CROP_INPUT_FMT_GREY
        default FOURCC_RGB16    if GMF_VIDEO_EFFECTS_CROP_INPUT_FMT_RGB565_LE
        default FOURCC_BGR16    if GMF_VIDEO_EFFECTS_CROP_INPUT_FMT_BGR565_LE
        default FOURCC_RGB16_BE if GMF_VIDEO_EFFECTS_CROP_INPUT_FMT_RGB565_BE
        default FOURCC_BGR16_BE if GMF_VIDEO_EFFECTS_CROP_INPUT_FMT_BGR565_BE
        default FOURCC_RGB24    if GMF_VIDEO_EFFECTS_CROP_INPUT_FMT_RGB888
        default FOURCC_BGR24    if GMF_VIDEO_EFFECTS_CROP_INPUT_FMT_BGR888
        default FOURCC_YUV      if GMF_VIDEO_EFFECTS_CROP_INPUT_FMT_YUV_PACKET

    config GMF_VIDEO_EFFECTS_CROP_X_POS
        int "X Position for Cropping"
        default 0
        range 0 GMF_VIDEO_EFFECTS_CROP_INPUT_WIDTH
        help
            The horizontal start position (in pixels) for cropping
            Must ensure that X position + output width <= input width
            Example:
                - Input width: 320
                - X position: 80
                - Output width: 160
            This will crop from pixel 80 to 240 horizontally

    config GMF_VIDEO_EFFECTS_CROP_Y_POS
        int "Y Position for Cropping"
        default 0
        range 0 GMF_VIDEO_EFFECTS_CROP_INPUT_HEIGHT
        help
            The vertical start position (in pixels) for cropping
            Must ensure that Y position + output height <= input height
            Example:
                - Input height: 240
                - Y position: 60
                - Output height: 120
            This will crop from pixel 60 to 180 vertically.

    config GMF_VIDEO_EFFECTS_CROP_OUTPUT_WIDTH
        int "Width of the Cropped Frame"
        default 160
        range 1 GMF_VIDEO_EFFECTS_CROP_INPUT_WIDTH
        help
            The width resolution of the output frame after cropping
            Must be less than or equal to (input width - X position)
            Example configurations:
            1. Center crop:
               - Input: 320x240
               - Position: (80,60)
               - Output: 160x120
            2. Edge crop:
               - Input: 320x240
               - Position: (0,0)
               - Output: 240x240

    config GMF_VIDEO_EFFECTS_CROP_OUTPUT_HEIGHT
        int "Height of the Cropped Frame"
        default 120
        range 1 GMF_VIDEO_EFFECTS_CROP_INPUT_HEIGHT
        help
            The height resolution of the output frame after cropping
            Must be less than or equal to (input height - Y position)
            Example configurations:
            1. Center crop:
               - Input: 320x240
               - Position: (80,60)
               - Output: 160x120
            2. Edge crop:
               - Input: 320x240
               - Position: (0,0)
               - Output: 320x180

endmenu
```
